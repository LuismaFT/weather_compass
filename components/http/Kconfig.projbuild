## components/http/Kconfig.projbuild
```kconfig
menu "Example Configuration"
    config EXAMPLE_HTTP_ENDPOINT
        string "Example HTTP Endpoint"
        default "demo.thingsboard.io"
        help
            Target endpoint host-name for the example to use.
endmenu
```
